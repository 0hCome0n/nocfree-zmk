## config/boards/nocfree/nocfree/dts/bindings/nocfree,expander-int-wake.yaml
```yaml
# Copyright (c) 2026 NocFree ZMK port
# SPDX-License-Identifier: MIT

description: |
  Arm nRF GPIO SENSE for SYSTEM OFF wake. Keys are polled over I2C expanders,
  so expander pins cannot wake the MCU. Stock ORs PCA9555 INT to one nRF pin;
  optional extra pins (e.g. mode-switch) provide a no-battery-disconnect
  recovery path if INT wake fails.

  On PM suspend (deep-sleep entry) each pin that is currently inactive is
  armed for LEVEL_ACTIVE sense. Already-active pins are skipped so a held
  mode-switch position cannot block SYSTEM OFF. On resume, sense is cleared.

compatible: "nocfree,expander-int-wake"

include: base.yaml

properties:
  int-gpios:
    type: phandle-array
    required: true
    description: |
      Primary expander INT net (active low, open-drain). Use GPIO_PULL_UP.
  extra-gpios:
    type: phandle-array
    required: false
    description: |
      Additional wake sources (e.g. mode-switch pins). Armed only when
      currently inactive so the selected switch position does not force
      immediate re-wake. Flip the switch to wake if key INT fails.
```

## config/dts/bindings/nocfree,mode-switch.yaml
```yaml
# Copyright (c) 2026 nocfree-zmk contributors
# SPDX-License-Identifier: MIT

description: |
  NocFree "&" three-position output-mode slide switch.

  The stock firmware reads two GPIOs and decodes THREE states from them, using
  "neither pin asserted" as the third. Both pins are INPUT_PULLUP and the slide
  contact shorts one of them to ground:

      2.4ghz-gpios asserted  ->  2.4 GHz   (dongle)
      bluetooth-gpios asserted ->  Bluetooth
      neither asserted       ->  wired     (USB)

  Note this is NOT the same shape as ZMK's `zmk_uno` SP3T example, which uses
  three GPIOs, one per detent, and drives `zmk,kscan-gpio-direct` in
  `toggle-mode`. That approach cannot express this switch: entering the wired
  position only produces a RELEASE of the previously asserted pin and no press,
  so a sideband binding would never fire and the endpoint would never return to
  USB. Hence a dedicated decoder.

  The switch shorts one of two pins (P0.17, P0.15) to ground, both otherwise
  held high via internal pull-ups, read with a CHANGE interrupt.

compatible: "nocfree,mode-switch"

include: base.yaml

properties:
  bluetooth-gpios:
    type: phandle-array
    required: true
    description: |
      Asserted when the switch is in the Bluetooth position. P0.15,
      active low with an internal pull-up.

  dongle-gpios:
    type: phandle-array
    required: true
    description: |
      Asserted when the switch is in the 2.4 GHz position. P0.17,
      active low with an internal pull-up.

      This pin short-circuits the truth table: when it is
      asserted the Bluetooth pin is never sampled at all. This driver keeps
      that precedence, so if both read asserted (a transient mid-slide, or a
      wiring fault) 2.4 GHz wins -- matching the vendor exactly.
```

## dongle_bridge/boards/nocfree/nocfree_bridge/Kconfig.nocfree_bridge
```kconfig
config BOARD_NOCFREE_BRIDGE
	select SOC_NRF52833_QIAA
	imply RETAINED_MEM
	imply RETENTION
	imply RETENTION_BOOT_MODE
```

## dongle_bridge/boards/nocfree/nocfree_bridge/board.yml
```yaml
board:
  name: nocfree_bridge
  full_name: "NocFree Dongle Bridge"
  vendor: nocfree
  socs:
    - name: nrf52833
```

## dongle_bridge/boards/nocfree/nocfree_bridge/nocfree_bridge_defconfig
```kconfig
# Board-level defaults for nocfree_bridge (nRF52833).
CONFIG_ARM_MPU=y
CONFIG_HW_STACK_PROTECTION=y
CONFIG_GPIO=y
CONFIG_PINCTRL=y
CONFIG_SERIAL=y
CONFIG_CONSOLE=y
CONFIG_UART_CONSOLE=y
```
